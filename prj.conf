## CMakeLists.txt
```
cmake_minimum_required(VERSION 3.20.0)
find_package(Zephyr REQUIRED HINTS $ENV{ZEPHYR_BASE})
project(legged_actuator_testbed)

target_sources(app PRIVATE src/main.cpp)
```

## prj.conf
```kconfig
CONFIG_CPP=y
CONFIG_STD_CPP20=y
CONFIG_PRINTK=y
```

## src/main.cpp
```c
#include <zephyr/kernel.h>
#include <zephyr/sys/printk.h>
#include <cstdint>

int main() {
    uint32_t counter = 0;

    while (true) {
        printk("Hello from C++20 on Zephyr! Tick: %u\n", counter++);
        k_msleep(1000);
    }

    return 0;
}
```
